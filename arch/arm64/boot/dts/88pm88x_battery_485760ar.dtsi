/*
* charger, battery parameters are based on Shenzhen B&k 485760AR battery using 88pm88x
* Part Name: Li-ion Polymer Rechargeable Battery
* Pack Standard: 2400mAh(0.2C)
* Cell Model: 485760AR(4.35V)
*/
&pmic0 {
	charger {
		prechg-current = <450>;
		prechg-voltage = <3000>;
		fastchg-voltage = <4350>;
		fastchg-cur = <1000>;
		fastchg-eoc = <20>;
		fastchg-tout = <8>;
		recharge-thr = <200>;
		dcp-limit = <2400>;
		status = "okay";
	};

	battery {
		bat-ntc-support = <1>;
		bat-capacity = <2500>;		/* mAh */
		ocv-table = <
		3476 3491 3509 3519 3527 3535 3545 3550 3556 3564
		3569 3574 3581 3586 3590 3596 3601 3606 3609 3614
		3617 3621 3626 3629 3632 3636 3639 3642 3647 3649
		3652 3655 3660 3663 3667 3672 3675 3679 3684 3688
		3692 3697 3701 3705 3710 3716 3721 3725 3732 3738
		3743 3751 3756 3762 3771 3777 3783 3789 3798 3804
		3811 3821 3828 3835 3845 3853 3860 3872 3880 3888
		3896 3909 3917 3926 3939 3948 3957 3969 3978 3987
		4001 4010 4019 4028 4042 4051 4061 4076 4086 4095
		4110 4120 4130 4140 4156 4166 4177 4194 4210 4234
		>;
		power-off-th = <3350>; /* mV */
		safe-power-off-th = <3000>; /* mV */

		/* battery temerature feature parameters */

		abs-lowest-temp = <20>;
		t1-degree = <0>;	/* -20C */
		t2-degree = <20>;	/* 0C */
		t3-degree = <50>;	/* 30C */
		t4-degree = <65>;	/* 45C */

		times-in-minus-ten = <2>;
		offset-in-minus-ten = <100>;
		times-in-zero = <1>;
		offset-in-zero = <0>;

		soc-low-th-cycle = <15>;
		soc-high-th-cycle = <85>;

		zero-degree-ohm = <145493>;

		/* -24C, -23C, ..., 62C, 63C */
		ntc-table =
		<524484 24>,
		<494913 23>,
		<467213 22>,
		<441252 21>,
		<416912 20>,
		<394080 19>,
		<372653 18>,
		<352535 17>,
		<333639 16>,
		<315882 15>,
		<299189 14>,
		<283489 13>,
		<268717 12>,
		<254812 11>,
		<241718 10>,
		<229383 9>,
		<217757 8>,
		<206797 7>,
		<196459 6>,
		<186705 5>,
		<177497 4>,
		<168803 3>,
		<160590 2>,
		<152829 1>, /* negative temperature */

		<145493 0>,
		<138554 1>,
		<131991 2>,
		<125779 3>,
		<119899 4>,
		<114330 5>,
		<109054 6>,
		<104054 7>,
		<99314  8>,
		<94820  9>,
		<90556  10>,
		<86510  11>,
		<82669  12>,
		<79022  13>,
		<75558  14>,
		<72266  15>,
		<69138  16>,
		<66163  17>,
		<63335  18>,
		<60644  19>,
		<58083  20>,
		<55645  21>,
		<53324  22>,
		<51113  23>,
		<49007  24>,
		<47000  25>,
		<45087  26>,
		<43262  27>,
		<41522  28>,
		<39862  29>,
		<38277  30>,
		<36765  31>,
		<35321  32>,
		<33942  33>,
		<32624  34>,
		<31365  35>,
		<30161  36>,
		<29011  37>,
		<27910  38>,
		<26858  39>,
		<25851  40>,
		<24887  41>,
		<23964  42>,
		<23081  43>,
		<22235  44>,
		<21425  45>,
		<20648  46>,
		<19904  47>,
		<19191  48>,
		<18507  49>,
		<17851  50>,
		<17221  51>,
		<16618  52>,
		<16038  53>,
		<15482  54>,
		<14948  55>,
		<14435  56>,
		<13943  57>,
		<13470  58>,
		<13015  59>,
		<12578  60>,
		<12158  61>,
		<11754  62>,
		<11366  63>;
	};
};
