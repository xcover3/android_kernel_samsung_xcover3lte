/*
 * Copyright (C) 2014 Marvell
 * Yi Zhang <yizhang@marvell.com>
 */

/*
 * 88pm886 parameters for the following battery model
 * Part Name: Li-ion Polymer Rechargeable Battery
 * Pack Parts No.: ALE455557SA
 * Pack Standard: 2000mAh(0.2C)
 * Cell Model: SP455557SA
 * Pack Model: 1S1P-SP455557SA-PCM
 */


&pmic0 {
	charger {
	};

	battery {
		bat-capacity = <2000>;	/* mAh */
		ocv-table = <
			3397 3445 3477 3496 3506 3513 3519 3526 3532 3540
			3551 3563 3576 3587 3600 3612 3625 3637 3649 3662
			3674 3687 3699 3709 3719 3727 3733 3739 3744 3748
			3752 3755 3758 3761 3763 3765 3766 3767 3769 3770
			3771 3772 3773 3774 3776 3777 3778 3780 3781 3784
			3786 3790 3794 3799 3805 3812 3819 3828 3838 3846
			3854 3860 3867 3873 3879 3885 3891 3897 3903 3910
			3916 3923 3930 3937 3944 3951 3959 3966 3973 3981
			3989 3997 4006 4015 4024 4034 4043 4053 4063 4073
			4082 4092 4102 4112 4122 4133 4144 4155 4167 4179
		>;
	};
};
