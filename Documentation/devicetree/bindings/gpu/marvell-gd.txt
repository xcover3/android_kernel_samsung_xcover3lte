## Documentation/devicetree/bindings/gpu/marvell-gd.txt
```
* Marvell 2D Graphics Accelerator

Required properties:
- compatible : should be "mrvl, xxx" for SoCs:
- reg: should be register base and length as documented in the
  SoC reference manual
- interrupts : Should contain the VPU interrupt. For CODA960,
  a second interrupt is needed for the MJPEG unit.
- clocks : Should contain the ahb and per clocks, in the order
  determined by the clock-names property.
- clock-names : Should be "ahb", "per"
- iram : phandle pointing to the SRAM device node

Example:
gpu: gpu@C0400000 {
	compatible = "marvell,gpu";
	reg = <0xC0400000 0x1000>;
	interrupts = <0 8 0x4>;
	status = "disabled";
};

gpu2d {
	compatible = "marvell,gpu2d";
	status = "disabled";
};
```

## Documentation/devicetree/bindings/hwmon/sensor_epl.txt
```
* epl ambient light + proximity sensors module
- compatible = "epl,epl2182"
- reg : register offset
- interrupts : interrupt
Example:
epl2182@49 {
	compatible = "epl,epl2182";
	reg = <0x49>;
	interrupt-parent = <&gpio>;
	interrupts = <4 0x1>;
	irq-gpios = <&gpio 4 0>;
	avdd-supply = <&ldo4>;
};
```

## Documentation/devicetree/bindings/input/touchscreen/msg2238.txt
```
* MSG2238 touchscreen driver

Required properties:
- compatible: must be "mstar,msg2238"

Example:

	twsi1: i2c@d4010800 {
		mstar@26 {
			compatible = "mstar,msg2238";
			pinctrl-names = "default";
			pinctrl-0 = <&touch_pins>;
			reg = <0x26>;
			interrupt-parent = <&gpio>;
			interrupts = <72 0x1>;
			mstar,abs-x-max = <720>;
			mstar,abs-y-max = <1280>;
			mstar,irq-gpios = <&gpio 72 0>;
			mstar,reset-gpios = <&gpio 75 0>;
			mstar,v_tsp-supply = <&ldo11>;
			status = "disabled";
		};
	};
```

## Documentation/devicetree/bindings/media/marvell-vpu.txt
```
* Marvell codec

Required properties:
- compatible : should be "mrvl, mmp-xxx" for SoCs:
- reg: should be register base and length as documented in the
  SoC reference manual
- interrupts : Should contain the VPU interrupt. For CODA960,
  a second interrupt is needed for the MJPEG unit.
- clocks : Should contain the ahb and per clocks, in the order
  determined by the clock-names property.
- clock-names : Should be "ahb", "per"
- iram : phandle pointing to the SRAM device node

Example:
coda7542: coda7542@d420d000 {
	compatible = "mrvl,mmp-coda7542";
	reg = <0xd420d000 0x1000>,
	      <0xd1004000 0x11600>;
	interrupts = <0 25 0x4>;
	marvell,power-domain = <&pd_vpu>;
	status = "disabled";
};
```

## Documentation/devicetree/bindings/media/mv_sc2_camera.txt
```
SoC camera driver for SC2.

mcam node
------------
Required properties:
- compatible	: should be "marvell,mv_sc2_camera";
- reg		: mcam1 or mcam2;
- marvell,power-domain	: power domain;

Example:
mcam0: mcam@0 {
	compatible = "marvell,mv_sc2_camera";
	marvell,power-domain = <&pd_sc2>;
	reg = <0x0 0x0>;
};
```

## Documentation/devicetree/bindings/mfd/88pm8xx.txt
```
* Marvell 88PM8xx Power Management IC

Required parent device properties:
- compatible : "marvell,88pm800"
- reg : the I2C slave address for the 88pm8xx chip
- interrupts : IRQ line for the 88pm8xx chip
- interrupt-controller: describes the 88pm8xx as an interrupt controller
- #interrupt-cells : should be 1.

parent device properties:
- marvell,88pm800-irq-write-clear: the irq clear method used


88pm800 consists of a group of sub-devices:

Device			 Description
------			 -----------
88pm80x-regulator	: regulator
88pm80x-headset		: headset
88pm80x-dvc		: dvc

Example:

pmic: 88pm800@30 {
	compatible = "marvell,88pm800";
	interrupt-controller;
	#interrupt-cells = <1>;

	marvell,88pm800-irq-write-clear;

	regulators {
		compatible = "marvell,88pm80x-regulator";
	};

	vibrator {
		  compatible = "marvell,88pm80x-vibrator";
	};

	headset {
		  compatible = "marvell,88pm80x-headset";
	};

	dvc {
		  compatible = "marvell,88pm8xx-dvc";
	};
      };
```

## Documentation/devicetree/bindings/misc/cp-load.txt
```
* Cp Load

Required properties:
- compatible: "marvell, cp_load"
- cp-type: 0 for pxa988, 1 for pxa1L88, 2 means pxa1928.
- lpm-qos: should be PM_QOS_CPUIDLE_BLOCK_AXI;

Examples:
	cp-load {
		compatible = "marvell,cp_load";
		cp-type = <1>;
		lpm-qos = <PM_QOS_CPUIDLE_BLOCK_AXI>;
		status = "okay";
	};
```

## Documentation/devicetree/bindings/misc/iml.txt
```
* IML driver.

Required properties:
- compatible: "marvell,mmp-iml"
- reg: the share memory address, RIPC lock address, RIPC clock address
- interrupts: the RIPC interrupt
- interrupt-names: name of the interrupt
- dmas: dma channel for rx
- dma-names: dma name

Examples:

iml: iml@7ffffe0{
	compatible = "marvell,mmp-iml";
	reg = <0x07ffffe0 0x10>, <0xd403d200 0x10>, <0xd403b038 0x10>;
	interrupts = <0 56 0x4>;
	interrupt-names = "IPC_MSA_DATA";
	dmas = <&pdma0 0xFF 0>;
	dma-names =  "iml-dma";
	status = "disabled";
};
```

## Documentation/devicetree/bindings/misc/mmp-debug.txt
```
* Marvell AXI timeout debug method

Required Properties:

- Compatibility : "marvell,mmp-debug"
- reg		: Address of the debug registers in squ domain

Example:

	debug: debug@d42a0000 {
		compatible = "marvell,mmp-debug";
		reg = <0xd42a0000 0x800>;
	};
```

## Documentation/devicetree/bindings/power/pd.txt
```
*Marvell power domain

Required properties:
- compatible:
  - "marvell,power-domain-display"
- clocks: related clocks with dispaly power domain

Examples:
pd_display: pd_display@0xd4282800 {
	compatible = "marvell,power-domain-display-pxa1928";
	reg = <0xd4282800 0x1000>;
	clocks = <&soc_clocks PXA1928_CLK_DISP_AXI_CLK>,
		<&soc_clocks PXA1928_CLK_DISP_ESC_CLK>,
		<&soc_clocks PXA1928_CLK_DISP_DISP1_EN>,
		<&soc_clocks PXA1928_CLK_DISP_VDMA_EN>;
	clock-names = "axi_clk", "esc_clk", "disp1_clk_gate", "vdma_clk_gate";
};

pd_display: pd_display@0xd4282800 {
	compatible = "marvell,power-domain-display-pxa1u88";
	reg = <0xd4282800 0x1000>;
	clocks = <&soc_clocks PXA1U88_CLK_DISP_HCLK>,
		<&soc_clocks PXA1U88_CLK_DSI_ESC>,
		<&soc_clocks PXA1U88_CLK_DISP1_EN>;
	clock-names = "LCDCIHCLK", "esc_clk", "disp1_clk_gate";

pd_gc: pd_gc@d4282800 {
	compatible = "marvell,power-domain-common-gc";
	reg = <0xd4282800 0x1000>;
};

pd_gc2d: pd_gc2d@d4282800 {
	compatible = "marvell,power-domain-common-gc2d";
	reg = <0xd4282800 0x1000>;
	clocks = <&soc_clocks PXA1U88_CLK_GC2D>;
};
```

## Documentation/devicetree/bindings/staging/iio/sensor_motion.txt
```
* Invensense motion sensors module
- compatible = "invensense,mpu9250"
- reg : register offset
- interrupts : interrupt
Example:
sensor: mpu9250@69 {
	        compatible = "invensense,mpu9250";
	        reg = <0x69>;
	        interrupts = <65 IRQ_TYPE_EDGE_FALLING>;
	        status = "okay";
	};
```

## Documentation/devicetree/bindings/watchdog/mmp-wdt.txt
```
* Marvell MMP Watchdog Time

Required Properties:

- Compatibility : "marvell,mmp-wdt"
- reg		: Address of the timer and main pmu registers

Optional properties:

-  marvell,mmp-wdt-disabled	: Used to decide whether watchdog timer needed.

Example:

	watchdog: wdt@d4080000 {
		compatible = "marvell,mmp-wdt";
		reg = <0xd4080000 0xc8>,
			  <0xd4050000 0x1024>;
		marvell,mmp-wdt-disabled;
	};
```

## drivers/cpuidle/Kconfig.arm64
```kconfig
#
# ARM64 CPU Idle drivers
#

config ARM64_CPUIDLE
	bool "Generic ARM64 CPU idle Driver"
	select ARM64_CPU_SUSPEND
	help
	  Select this to enable generic cpuidle driver for ARM v8.
	  It provides a driver for testing purpose on ARM v8 models based
	  on cpu_suspend API for entering power down modes.
```

## drivers/hwmon/lsm6ds3/Kconfig
```kconfig
config INPUT_LSM6DS3
         tristate "STMicroelectronics LSM6DS3 sensor"
         depends on I2C && SYSFS
         help
           This driver support the STMicroelectronics LSM6DS3 sensor.To compile this driver as a module, choose M here. The module will be called lsm6ds3.

if INPUT_LSM6DS3
choice
	prompt "LSM6DS3 bus selection"
	default INPUT_LSM6DS3_I2C

config INPUT_LSM6DS3_I2C
	bool "I2C"

config INPUT_LSM6DS3_SPI
	bool "SPI"
endchoice

choice
	prompt "LSM6DS3 mode selection"
	default LSM6DS3_POLLING_MODE

config LSM6DS3_POLLING_MODE
	bool "Polling"

config LSM6DS3_FIFO_MODE
	bool "FIFO trigger"
endchoice

endif
```

## drivers/input/touchscreen/mstarTouchPanel/Kconfig
```kconfig
#
# TI's mstar Touchscreen driver.
#
config TOUCHSCREEN_MSTAR
        tristate "MSTAR touchscreen driver"
	depends on I2C
		help
		Say Y here if enable support for the MSTAR touchscreen controller.
```

## drivers/marvell/Kconfig
```kconfig
menuconfig MARVELL_DRIVERS
	bool "Marvell kernel module drivers"
	---help---
	  marvell kernel module drivers

if MARVELL_DRIVERS

config MRVL_WIRELESS
	bool "marvell wireless driver"
	---help---
	This enables the marvell wireless driver for application processor

choice
	depends on MRVL_WIRELESS
	bool "Choose the chip for marvell wireless"
	default MRVL_WL_SD8777

config MRVL_WL_SD8777
	bool "SD8777"
	---help---
	Marvell NIC driver: SD8777 chip

config MRVL_WL_SD8787
	bool "SD8787"
	---help---
	Marvell NIC driver: SD8787 chip

config MRVL_WL_SD8887
	bool "SD8887"
	---help---
	Marvell NIC driver: SD8887 chip

config MRVL_WL_SD8897
	bool "SD8897"
	---help---
	Temporarily maintain SD8897 specifically, this item will be
	removed when Marvell combo driver support SD8897

config MRVL_WL_SD8XXX
	bool "SD8787/SD8777/SD8801/SD8887"
	---help---
	Marvell combo driver support: SD8787/SD8777/SD8801/SD8887 chips

endchoice

config MRVL_WL_BUILD_TYPE
	depends on MRVL_WL_SD8777 || MRVL_WL_SD8787 || MRVL_WL_SD8887 || MRVL_WL_SD8897 || (MRVL_WL_SD8XXX && m)
	tristate "Build type of the driver for MARVELL wireless"
	default m
	---help---
	Choose <m> if you want to build the driver as module;
	<y> to build-in kernel; <n> if you do not want to build.

config MRVL_DEBUG
	tristate "Support Marvell debug features"
	default y
	---help---
	  This will enable Marvell debug features.

config MRVL_TZDD
	tristate "Marvell Trust Zone Device Driver"
	default n
	help
	  Marvell Trust Execution Environment (TEE) Solution in non-trusted world

config MRVL_SW_JTAG
	tristate "Marvell software jtag driver"
	default n
	help
	  Marvell software jtag driver to simulate jtag access

config MRVL_PANIC_FLUSH
        bool "cache flush when panic"
        depends on KEXEC
        help
          Enable support for flush all cache during panic

config PXA_RAMDUMP
        bool "marvell ramdump driver"
        help
          marvell ramdump driver

config MRVL_SKMALLOC
	tristate "Marvell Supper Kmalloc Driver"
	default y
	---help---
	Create skmalloc-xxx like as kmalloc-xxx.
	Driver or module can use these skmalloc caches which will
	be different with kmalloc-xxx.
	Use this method will be helpful for kmalloc issue debugging.

config SKMALLOC_REBOOT_NOTIFY
	tristate "support changing skm_dbg_level by reboot cmd"
	depends on MRVL_SKMALLOC && KEXEC
	default y
	---help---
	If you want, you can change skm_dbg_level by reboot cmd,
	like "reboot skm_dbg_level=2". Set this value to 0 will disable skmalloc;
	set to 1, will create skmalloc-xxx with kernel default debug flags;
	set to 2, which force enable all the debug flags for the skmalloc-xxx.

config MRVL_SKMALLOC_WIRELESS_EN
	tristate "marvell wireless driver use skmalloc"
	depends on MRVL_SKMALLOC && MRVL_WIRELESS
	default y
	---help---
	Whether marvell wireless driver uses Supper Kmalloc or not.
	After enable this config, all the kmalloc used in marvell wireless
	driver will use skmalloc-xxx instead of kmalloc-xxx.

config MRVL_MMP_MODEM
	tristate "Marvell mmp modem driver"
	default n
	help
	  Marvell MMP modem driver for communication processor

config MRVL_MMP_CM3
	tristate "Marvell CM3 resource manager driver"
	default n
	help
	  Marvell CM3 resource manager driver for PXA1U88

endif
```

## drivers/media/i2c/b52_camera/Kconfig
```kconfig
comment "b52_camera sensor drivers"

config B52_CAMERA_OV13850
	tristate "OV13850 sensor support"
	depends on VIDEO_MMPISP_B52SENSOR && I2C
	help
	  This is a V4L2 camera driver for the ov13850 sensor.

config B52_CAMERA_IMX219
	tristate "imx219 sensor support"
	depends on VIDEO_MMPISP_B52SENSOR && I2C
	help
	  This is a V4L2 camera driver for the imx219 sensor.

config B52_CAMERA_OV5648
       tristate "OV5648 camera support"
       depends on VIDEO_MMPISP_B52 && I2C
       help
        This is a V4L2 camera driver for the ov5648 sensor

config B52_CAMERA_OV2680
       tristate "OV2680 camera support"
       depends on VIDEO_MMPISP_B52 && I2C
       help
        This is a V4L2 camera driver for the ov2680 sensor

config B52_CAMERA_OV8858
       tristate "OV8858 camera support"
       depends on VIDEO_MMPISP_B52 && I2C
       help
	This is a V4L2 camera driver for the ov8858 sensor

config B52_CAMERA_SR544
       tristate "SR544 camera support"
       depends on VIDEO_MMPISP_B52 && I2C
       help
	This is a V4L2 camera driver for the sr544 sensor
```

## drivers/power/marvell/power_domain/Kconfig
```kconfig
menuconfig MMP_PM_DOMAIN
	bool "power domain support for mmp"
	depends on PM_GENERIC_DOMAINS
	help
	  Say Y to enable support for the power domain managment for
	  Marvell mmp SOCes.
	  It will includes the APIs and help functions for specific
	  power domains. The power domain will provide power for
	  VPU/GC/ISP and etc.

if MMP_PM_DOMAIN

config MMP_PM_DOMAIN_COMMON
        bool "power domain for vpu/gc/isp"
        help
          Say Y here to enable related power domain for pxa1088/pxa1L88

endif
```

## drivers/video/mmp/hw/Kconfig
```kconfig
if MMP_DISP

config MMP_DISP_CONTROLLER
	bool "mmp display controller hw support"
	default y
	help
		Marvell MMP display hw controller support
		this controller is used on Marvell PXA910
		MMP2 MMP3 PXA988 PXA1L88 PXA1U88 PXA1928 chips
		will register vdma, ctrl, dsi, panel for
		display

config MMP_DISP_SPI
	bool "mmp display controller spi port"
	depends on MMP_DISP_CONTROLLER && SPI_MASTER
	default y
	help
		Marvell MMP display hw controller spi port support
		will register as a spi master for panel usage

config MMP_VIRTUAL_RESOLUTION
	bool "support virtual resulution"
	depends on MMP_DISP_CONTROLLER
	default n
	help
		Enable virtual resolution feature to support simulate
		some resolution which current panel can't support or
		no such panel of resolution

config MMP_VIRTUAL_RESOLUTION_X
	int "virtual resolution x (0~1920)"
	depends on MMP_VIRTUAL_RESOLUTION
	range 0 1920
	default 720
	help
		Set the x resolution for virtual resolution

config MMP_VIRTUAL_RESOLUTION_Y
	int "virtual resolution y (0~1920)"
	depends on MMP_VIRTUAL_RESOLUTION
	range 0 1920
	default 1280
	help
		Set the y resolution for virtual resolution
endif
```

## drivers/video/mmp/panel/Kconfig
```kconfig
config MMP_PANEL_TPOHVGA
	bool "tpohvga panel TJ032MD01BW support"
	depends on SPI_MASTER
	default n
	help
		tpohvga panel support

config MMP_PANEL_HX8394_IPS3P5071
	bool "MIPI panel hx8394-ips3p5071 support"
	default n
	help
		MIPI panel hx8394-ips3p5071 support

config MMP_PANEL_R63311
	bool "MIPI Sharp panel R63311 support"
	default n
	help
		MIPI Sharp 1080p panel support

config MMP_PANEL_COMMON
	bool "MIPI common panel support"
	default n
	help
		MIPI common panel support

config MMP_PANEL_LG4591
	bool "MIPI panel LG4591 support"
	default n
	help
		MIPI panel LG4591 support

config MMP_PANEL_OTM1281A
	bool "MIPI panel OTM1281A support"
	default n
	help
		MIPI panel OTM1281A support

config MMP_PANEL_TD043MGEA1
	bool "parallel panel TD043MGEA1 support"
	default n
	help
		parallel panel TD043MGEA1 support

config MMP_PANEL_HX8394
	bool "MIPI panel hx8394 support"
	default n
	help
		MIPI panel hx8394 support
```
